## Kconfig
```kconfig
# SPDX-License-Identifier: GPL-3.0-or-later

menuconfig LPKG_USING_RT_CARPLAY
    bool "rt-carplay: AirPlay/iAP2 CarPlay receiver"
    default n
    depends on LPKG_USING_MBEDTLS
    help
        Portable CarPlay (wireless iAP2 + AirPlay) receiver core with an
        RT-Thread OS/socket port.  Requires mbedTLS 2.x built with
        MBEDTLS_CHACHA20_C, MBEDTLS_POLY1305_C, MBEDTLS_CHACHAPOLY_C and
        MBEDTLS_HKDF_C; see port/luban-lite/README.md.

if LPKG_USING_RT_CARPLAY

config LPKG_RT_CARPLAY_LOG
    bool "Enable rt-carplay logging"
    default y
    help
        Route RTCP_LOGx() output through rt_kprintf().  Turn off to drop the
        logging strings from the image.

config LPKG_RT_CARPLAY_ED25519
    bool "Vendored software Ed25519 identity"
    default y
    help
        Compile orlp/ed25519 (zlib license, third_party/ed25519) and the
        airplay_ed25519 wrapper.  This is the software signing identity used
        by Pair-Setup / Pair-Verify; without it the application must provide
        its own sign/verify callbacks (for example a hardware-backed key).

config LPKG_RT_CARPLAY_AUDIO_CODECS
    bool "Fixed-point AAC-LC and Opus audio codecs"
    default y
    help
        Build vendored FAAD2 (GPL-2.0-or-later, LC only) and Opus
        (BSD-3-Clause) sources. Does not use the SDK binary codec archives.
        Disable for a PCM-only receiver; compressed formats are then refused.

config LPKG_RT_CARPLAY_HEADLESS_EXAMPLE
    bool "Build the standalone filesystem-backed Headless example"
    default n
    depends on LPKG_RT_CARPLAY_ED25519
    help
        Build examples/rtthread_headless/headless.c without a GUI or board
        adapter. The host calls rtcp_headless_run() on its ordinary worker
        after network/filesystem startup and supplies a real secure random
        provider. This option does not autostart a second receiver.

endif
```
